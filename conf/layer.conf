## conf/layer.conf
```bitbake
# We have a conf and classes directory, add to BBPATH
BBPATH .= ":${LAYERDIR}"

# We have recipes-* directories, add to BBFILES
BBFILES += "${LAYERDIR}/recipes-*/*/*.bb \
            ${LAYERDIR}/recipes-*/*/*.bbappend"

BBFILE_COLLECTIONS += "meta-ar1100"
BBFILE_PATTERN_meta-ar1100 = "^${LAYERDIR}/"
BBFILE_PRIORITY_meta-ar1100 = "6"

LAYERDEPENDS_meta-ar1100 = "core"
LAYERSERIES_COMPAT_meta-ar1100 = " sumo thud warrior zeus"
```
